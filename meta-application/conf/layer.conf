## meta-application/conf/layer.conf
```bitbake
# We have a conf and recipes-* directory, add to BBPATH
BBPATH .= ":${LAYERDIR}"

# Look for .bb and .bbappend files in recipes-* subdirs
BBFILES += "${LAYERDIR}/recipes-*/*/*.bb \
            ${LAYERDIR}/recipes-*/*/*.bbappend"

# Declare collection
BBFILE_COLLECTIONS += "meta-application"
BBFILE_PATTERN_meta-application = "^${LAYERDIR}/"
BBFILE_PRIORITY_meta-application = "6"

LAYERDEPENDS_meta-application = "core"
LAYERSERIES_COMPAT_meta-application = "kirkstone"
```
